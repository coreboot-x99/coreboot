## src/cpu/intel/grantley/Kconfig
```kconfig
## SPDX-License-Identifier: GPL-2.0-only

config CPU_INTEL_GRANTLEY
	bool
	select ARCH_X86
	select SSE2
	select UDELAY_TSC
	select TSC_MONOTONIC_TIMER
	select TSC_SYNC_MFENCE
	select CPU_INTEL_COMMON
	select CPU_INTEL_COMMON_TIMEBASE
	select HAVE_INSMM_STS
	select SUPPORT_CPU_UCODE_IN_CBFS
	select MICROCODE_UPDATE_PRE_RAM
	# Port I/O requires SAD routing, installed by the CPU CAR entry.
	select NO_EARLY_BOOTBLOCK_POSTCODES
	select CPU_INTEL_FIRMWARE_INTERFACE_TABLE
	select SIPI_VECTOR_IN_ROM # We have a lot of early ASM

if CPU_INTEL_GRANTLEY

config SMM_TSEG_SIZE
	hex
	default 0x800000

config IED_REGION_SIZE
	hex
	default 0x400000

config SMM_RESERVED_SIZE
	hex
	default 0x100000

# Xeon E5-2699 v4 has 22 cores and 44 threads
config MAX_CPUS
	default 44  if MAX_SOCKET <= 1
	default 88  if MAX_SOCKET <= 2
	default 176 if MAX_SOCKET <= 4

endif
```
